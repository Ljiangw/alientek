## boards/openedv/stm32h743i_apollo/Kconfig.defconfig
```kconfig
# STM32H743II APOLLO board configuration

# Copyright (c) 2020 Teslabs Engineering S.L.
# SPDX-License-Identifier: Apache-2.0

if BOARD_STM32H743I_APOLLO

if NETWORKING

config NET_L2_ETHERNET
	default y

endif # NETWORKING

endif # BOARD_STM32H743I_APOLLO
```

## boards/openedv/stm32h743i_apollo/Kconfig.stm32h743i_apollo
```kconfig
# Copyright (c) 2020 Teslabs Engineering S.L.
# SPDX-License-Identifier: Apache-2.0

config BOARD_STM32H743I_APOLLO
	select SOC_STM32H743XX
```

## boards/openedv/stm32h743i_apollo/board.yml
```yaml
board:
  name: stm32h743i_apollo
  full_name: Apollo H743IIT6
  vendor: openedv
  socs:
    - name: stm32h743xx
```

## drivers/ap3216c/Kconfig
```kconfig
config AP3216C
	bool "AP3216C Ambient Light and Proximity Sensor"
	default n
	depends on DT_HAS_LITEON_AP3216C_ENABLED
	select I2C
	help
	  Enable driver for the AP3216C Ambient Light and Proximity Sensor.
```

## drivers/button/Kconfig
```kconfig
# Create a new option in menuconfig
config CUSTOM_BUTTON
    bool "Custom Button Driver"
    default n
    depends on GPIO
    help
      Enable the custom button driver for handling button inputs.
```

## drivers/flash/Kconfig
```kconfig
# Create a new option in menuconfig
config ALIENTEK_FLASH
    bool "alientek flash driver"
    default y
	depends on DT_HAS_ALIENTEK_STM32_QSPI_NOR_ENABLED
	select USE_STM32_HAL_QSPI
	select USE_STM32_HAL_MDMA if SOC_SERIES_STM32H7X
	select FLASH_HAS_DRIVER_ENABLED
	select FLASH_JESD216
	select FLASH_HAS_PAGE_LAYOUT
	select FLASH_HAS_EXPLICIT_ERASE
	select PINCTRL
	# select DMA
	# select USE_STM32_HAL_DMA
	help
	  Enable QSPI-NOR support on the STM32 family of processors.

if ALIENTEK_FLASH

config FLASH_STM32_QSPI_GENERIC_READ
	bool "Generic read command extended operation"
	select FLASH_HAS_EX_OP
	help
	  Enables flash extended operation that can be used to transmit
	  a custom command and read the result to a user-provided buffer.

config FLASH_STM32_QSPI_GENERIC_WRITE
	bool "Generic write command extended operation"
	select FLASH_HAS_EX_OP
	help
	  Enables flash extended operation that can be used to transmit
	  a custom command and write data taken from a user-provided
	  buffer.

endif # FLASH_STM32_QSPI
```

## dts/bindings/sensor/liteon,ap3216c.yaml
```yaml
description: |
    AP3216C Ambient Light and Proximity Sensor. 

compatible: "liteon,ap3216c"

include: [sensor-device.yaml, i2c-device.yaml]
```
